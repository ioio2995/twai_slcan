## components/led_rgb/Kconfig.projbuild
```kconfig
menu "APP - Led RGB settings"
    ####################
    #    RGB CONFIG    #
    ####################
            
        config APP_RGB_RED
            int "RGB Red pin"
            range 0 46
            default 36
            help
                Select red pin for RGB connection.
    
        config APP_RGB_GREEN
            int "RGB Green pin"
            range 0 46
            default 37
            help
                Select green pin for RGB connection.
    
        config APP_RGB_BLUE
            int "RGB Blue pin"
            range 0 46
            default 35
            help
                Select blue pin for RGB connection.     
    endmenu
```

## main/Kconfig.projbuild
```kconfig
menu "APP - TWAI settings"
#####################
#    TWAI CONFIG    #
#####################
        
    config APP_TWAI_TX
        int "TWAI TX pin"
        range 0 46
        default 39
        help
            Select Tx pin for twai connection.

    config APP_TWAI_RX
        int "TWAI RX pin"
        range 0 46
        default 38
        help
            Select Rx pin for twai connection.           

    config APP_TWAI_TX_TIMEOUT
        int "TWAI TX timeout"
        range 0 1000000000
        default 1000000
        help
            Number of FreeRTOS ticks to block on the TX queue.

    config APP_TWAI_RX_TIMEOUT
        int "TWAI RX timeout"
        range 0 1000000000
        default 1000000
        help
            Number of FreeRTOS ticks to block on the RX queue.
endmenu
```

## sdkconfig.defaults
```kconfig
#
# APP - TWAI settings
#
CONFIG_APP_TWAI_TX=6
CONFIG_APP_TWAI_RX=8
CONFIG_APP_TWAI_TX_TIMEOUT=1000000
CONFIG_APP_TWAI_RX_TIMEOUT=1000000
# end of APP - TWAI settings

#
# APP - Led RGB settings
#
CONFIG_APP_RGB_RED=36
CONFIG_APP_RGB_GREEN=37
CONFIG_APP_RGB_BLUE=35
# end of APP - Led RGB settings

#
# Massive Storage Class (MSC)
#
# CONFIG_TINYUSB_MSC_ENABLED is not set
# end of Massive Storage Class (MSC)

#
# Communication Device Class (CDC)
#
CONFIG_TINYUSB_CDC_ENABLED=y
CONFIG_TINYUSB_CDC_COUNT=1
CONFIG_TINYUSB_CDC_RX_BUFSIZE=512
CONFIG_TINYUSB_CDC_TX_BUFSIZE=512
# end of Communication Device Class (CDC)
```
